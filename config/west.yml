## config/west.yml
```yaml
manifest:
  remotes:
    - name: zmkfirmware
      url-base: https://github.com/zmkfirmware
    - name: duckyb
      url-base: https://github.com/duckyb
    - name: m165437
      url-base: https://github.com/M165437
    - name: kevinpastor
      url-base: https://github.com/kevinpastor
  projects:
    - name: zmk
      remote: zmkfirmware
      revision: 9917e2f1371d5bb051bf8eb782c1297db41d742b  # main @ 2026-05-22
      import: app/west.yml
    - name: urchin-zmk-module
      remote: duckyb
      revision: a3ab64fa7779f82675695f3d7d17f705f840da25  # main @ 2026-05-22
    - name: nice-view-gem
      remote: m165437
      revision: 0a50fe209d929c916c5664c6affd0f4977c6b012  # main @ 2026-05-22
    - name: nice-view-elemental
      remote: kevinpastor
      revision: 2915ad65a55866f4958b5dd7b557462ad28e9a07  # update-to-zmk-0.4 @ 2026-05-22
  self:
    path: config
```
